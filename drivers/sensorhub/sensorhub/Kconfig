## drivers/sensorhub/sensorhub/Kconfig
```kconfig
config SHUB_MODULE
	tristate "shub module"
	default n

config SHUB_FIRMWARE_DOWNLOAD
	tristate "Sensor hub firmware download"
	default n

config SHUB_AP_STATUS_CMD
	tristate "Sensor hub ap status command"
        default n
        help
        If you say yes, send command to sensorhub when AP suspend or resume.

config SHUB_SPU
	tristate "Sensor hub spu firmware download"
	default n
```
